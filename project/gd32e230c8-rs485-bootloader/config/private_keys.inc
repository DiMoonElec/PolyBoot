/*
    Тестовые ключи шифрования.
    В дальнейшем заменить на актуальные ключи, 
    и хранить их в секрете.
    Ключи шифрования можно сгенерировать утилитой 
    PolyBootGen https://github.com/DiMoonElec/PolyBootGen
    Эта же утилита позволяет сгенерировать валидный файл обновления
    для данного Bootloader-а.
*/

static const uint8_t EncryptionKey[32] =
{
    0x01, 0x23, 0x45, 0x67, 0x89, 0xAB, 0xCD, 0xEF, 
    0x01, 0x23, 0x45, 0x67, 0x89, 0xAB, 0xCD, 0xEF, 
    0x01, 0x23, 0x45, 0x67, 0x89, 0xAB, 0xCD, 0xEF, 
    0x01, 0x23, 0x45, 0x67, 0x89, 0xAB, 0xCD, 0xEF,
};

static const uint8_t IntegrityKey[32] =
{
    0x01, 0x23, 0x45, 0x67, 0x89, 0xAB, 0xCD, 0xEF, 
    0x01, 0x23, 0x45, 0x67, 0x89, 0xAB, 0xCD, 0xEF, 
    0x01, 0x23, 0x45, 0x67, 0x89, 0xAB, 0xCD, 0xEF, 
    0x01, 0x23, 0x45, 0x67, 0x89, 0xAB, 0xCD, 0xEF,
};
